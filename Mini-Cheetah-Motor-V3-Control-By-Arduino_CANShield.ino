/*-------------------------------------------------------------------------------
Created on Sat Feb 27 2021

@Author: Jihwan Lee
@GIT ID: DGIRobo
@E-mail: fist5678@dgist.ac.kr
@Department: Daegu Gyeongbuk Institute of Science and Technology(DGIST) Undergraduate Course
-------------------------------------------------------------------------------*/
#include <mcp_can.h>
#include <SPI.h>
#include "gim8008V3.h"
//-----------------------------------------------------------------------------------------------------------------------------------------------------------------------------------------------------------------------------------------------------------//
#ifdef ARDUINO_SMD_VARIANT_COMPLANCE
  #define SERIAL SerialUSB
#else
  #define SERIAL Serial
#endif
//-----------------------------------------------------------------------------------------------------------------------------------------------------------------------------------------------------------------------------------------------------------//
#define UP    A1
#define DOWN  A3
#define LEFT  A2
#define RIGHT A5
#define CLICK A4
//-----------------------------------------------------------------------------------------------------------------------------------------------------------------------------------------------------------------------------------------------------------//
#define LED2 8
#define LED3 7
//-----------------------------------------------------------------------------------------------------------------------------------------------------------------------------------------------------------------------------------------------------------//
//VARIABLES PARA CONTROLAR EL TIEMPO
unsigned long previousMillis = 0;
const long interval = 20;
unsigned long arduinoLoopTime;
unsigned long previousLooptime;
double t;
//-----------------------------------------------------------------------------------------------------------------------------------------------------------------------------------------------------------------------------------------------------------//
gim8008V3 motor(1, 205, 5);
//-----------------------------------------------------------------------------------------------------------------------------------------------------------------------------------------------------------------------------------------------------------//
float actPos0 = 0;
//-----------------------------------------------------------------------------------------------------------------------------------------------------------------------------------------------------------------------------------------------------------//
const int SPI_CS_PIN = 10;
MCP_CAN CAN(SPI_CS_PIN);
//-----------------------------------------------------------------------------------------------------------------------------------------------------------------------------------------------------------------------------------------------------------//
void setup() {
  SERIAL.begin(115200);
  delay(1000);
  while (CAN_OK != CAN.begin(CAN_1000KBPS))
  {
    SERIAL.println("CAN BUS Shield init fail");
    SERIAL.println("Init CAN BUST Shield again");
    delay(100);
  }
  SERIAL.println("CAN BUS Shield init ok!");

  pinMode(UP, INPUT);
  pinMode(DOWN, INPUT);
  pinMode(LEFT, INPUT);
  pinMode(RIGHT, INPUT);
  pinMode(LED2, OUTPUT);
  pinMode(LED3, OUTPUT);

  digitalWrite(UP, HIGH);
  digitalWrite(DOWN, HIGH);
  digitalWrite(LEFT, HIGH);
  digitalWrite(RIGHT, HIGH);
  
  digitalWrite(LED2, LOW);
  digitalWrite(LED3, LOW);
}
//-----------------------------------------------------------------------------------------------------------------------------------------------------------------------------------------------------------------------------------------------------------//

//-----------------------------------------------------------------------------------------------------------------------------------------------------------------------------------------------------------------------------------------------------------//
void loop() {
  int motorset = 0;
  //-----------------------------------------------------------------------------------------------------------------------------------------------------------------------------------------------------------------------------------------------------------//
  unsigned long currentMillis = millis();
  if (currentMillis - previousMillis >= interval) {
    // save the last time you blinked the LED
    previousMillis = currentMillis;
    t = float(currentMillis) / 1000;
    
    if (digitalRead(UP) == LOW)
    {
      motorset = motor.setMotormode(CAN);
    }
  
    if (digitalRead(DOWN) == LOW)
    {
      motorset = motor.exitMotormode(CAN);
    }

    if (digitalRead(RIGHT) == LOW)
    {
      motorset = motor.setZero(CAN);
    }
  
    actPos0 = motor.normalSet(CAN, 1, 0, 0); Put in order: CANObject, desirePosition(rad), maxVelocity(rad/s), maxTorque(rad/s^2)
  }
}
